/*
 * Copyright (c) 2025 Analog Devices, Inc.
 *
 * SPDX-License-Identifier: Apache-2.0
 */

/dts-v1/;

#include <adi/max32/max32690-m4.dtsi>
#include "ethernet_apl_device_max32690_m4-common.dtsi"

comms_spi: &spi4 {
	pinctrl-0 = <&spi4a_ss0_p1_0 &spi4a_miso_p1_2 &spi4a_mosi_p1_1 &spi4a_sck_p1_3>;
	cs-gpios = <&gpio1 0 (GPIO_ACTIVE_LOW | GPIO_PULL_UP)>;
};

/* Pin setup for debugging RV32 core */
&cpu1 {
	pinctrl-0 = <&rv_tck_p0_19 &rv_tms_p0_20 &rv_tdi_p0_21 &rv_tdo_p0_22>;
	pinctrl-names = "default";
};

#include "ethernet_apl_device_max32690_m4-adin1110.dtsi"