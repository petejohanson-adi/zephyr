## boards/adi/ethernet_apl_device/Kconfig.defconfig
```kconfig
# Ethernet APL Device boards configuration

# Copyright (c) 2026 Analog Devices, Inc.
# SPDX-License-Identifier: Apache-2.0

if BOARD_ETHERNET_APL_DEVICE

config MDIO_INIT_PRIORITY
	default 81
	depends on MDIO

config PHY_INIT_PRIORITY
	default 82
	depends on NET_L2_ETHERNET && ETH_DRIVER

if NETWORKING

config NET_L2_ETHERNET
	default y

endif # NETWORKING

endif # BOARD_ETHERNET_APL_DEVICE
```

## boards/adi/ethernet_apl_device/Kconfig.ethernet_apl_device
```kconfig
# Ethernet APL Device board configuration

# Copyright (c) 2026 Analog Devices, Inc.
# SPDX-License-Identifier: Apache-2.0

config BOARD_ETHERNET_APL_DEVICE
	select SOC_MAX32690_M4 if BOARD_ETHERNET_APL_DEVICE_MAX32690_M4 || BOARD_ETHERNET_APL_DEVICE_MAX32690_M4_NON_IS
	select SOC_MAX32690_RV32 if BOARD_ETHERNET_APL_DEVICE_MAX32690_RV32
```

## boards/adi/ethernet_apl_device/board.yml
```yaml
# Copyright (c) 2026 Analog Devices, Inc.
# SPDX-License-Identifier: Apache-2.0

board:
  name: ethernet_apl_device
  full_name: Ethernet APL Device
  vendor: adi
  socs:
    - name: max32690
      variants:
        - name: non_is
          cpucluster: 'm4'
```

## drivers/mbox/Kconfig.adi_max32
```kconfig
# Copyright 2025 Analog Devices, Inc
# SPDX-License-Identifier: Apache-2.0

config MBOX_ADI_MAX32_SEMAPHORE
	bool "ADI MAX32 semaphore mailbox driver"
	default y
	depends on DT_HAS_ADI_MBOX_MAX32_SEMAPHORE_ENABLED
	help
	  Driver for ADI MAX32 Semaphore peripheral mailbox
	  functionality.
```

## dts/bindings/op_points/zephyr,op-points.yaml
```yaml
# Copyright (c) 2026 Analog Devices, Inc
# SPDX-License-Identifier: Apache-2.0

compatible: "zephyr,op-points"

description: TODO

child-binding:
  properties:
    p-states:
      type: phandles
      required: true
      description:
        The allowed p-states when in this operating point

    devices:
      type: phandles
      description:
        The devices to resume or get (when using device PM) to ensure they are
        enabled when in the given operating point
```

## soc/adi/max32/Kconfig.defconfig
```kconfig
# Analog Devices MAX32xxx MCU family

# Copyright (c) 2023-2024 Analog Devices, Inc.
# SPDX-License-Identifier: Apache-2.0

if SOC_FAMILY_MAX32

rsource "Kconfig.defconfig.max*"

if SOC_FAMILY_MAX32_M4 || SOC_FAMILY_MAX32_M33

config SRAM_VECTOR_TABLE
	default y

endif

if SOC_FAMILY_MAX32_RV32

config RISCV_TRAP_HANDLER_ALIGNMENT
	default 256

config ARCH_SW_ISR_TABLE_ALIGN
	default 32

config RISCV_SOC_CONTEXT_SAVE
	default y

config RISCV_SOC_OFFSETS
	default y

config RISCV_MCAUSE_EXCEPTION_MASK
	default 0xFFF

endif

endif # SOC_FAMILY_MAX32
```

## subsys/op_points/Kconfig
```kconfig
# Copyright (c) 2026 Analog Devices, Inc
# SPDX-License-Identifier: Apache-2.0

menuconfig OP_POINTS
	bool "Operating Points"
	select CPU_FREQ
	select CPU_FREQ_CONSTRAINTS

if OP_POINTS


module = OP_POINTS
module-str = Operating Points
source "subsys/logging/Kconfig.template.log_config"

endif # OP_POINTS
```

## tests/kernel/tickless/tickless_concept/testcase.yaml
```yaml
tests:
  kernel.tickless.concept:
    platform_exclude:
      - litex_vexriscv
      - rv32m1_vega/openisa_rv32m1/zero_riscy
      - rv32m1_vega/openisa_rv32m1/ri5cy
      - nrf5340dk/nrf5340/cpunet
      - nucleo_l073rz
      - max78002evkit/max78002/rv32
    tags:
      - kernel
      - pm
```
