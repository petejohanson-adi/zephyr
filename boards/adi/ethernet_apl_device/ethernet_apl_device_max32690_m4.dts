/*
 * Copyright (c) 2025 Analog Devices, Inc.
 *
 * SPDX-License-Identifier: Apache-2.0
 */

/dts-v1/;

#include <adi/max32/max32690-m4.dtsi>
#include "ethernet_apl_device_max32690_m4-common.dtsi"

/* MAXQ1065 bus */
&spi2 {
	status = "okay";
	pinctrl-0 = <&spi2a_mosi_p2_4 &spi2a_miso_p2_3 &spi2a_sck_p2_2>;
	pinctrl-names = "default";

	cs-gpios = <&gpio2 5 GPIO_ACTIVE_LOW>;
};

comms_spi: &spi3 {
	pinctrl-0 = <&spi3a_miso_p0_20 &spi3a_mosi_p0_21 &spi3a_sck_p0_16>;
	cs-gpios = <&gpio0 19 (GPIO_ACTIVE_LOW | GPIO_PULL_UP)>;
	pinctrl-names = "default";
	status = "okay";
};

#include "ethernet_apl_device_max32690_m4-adin1110.dtsi"