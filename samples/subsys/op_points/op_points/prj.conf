## sample.yaml
```
# Copyright 2026 Analog Devices, Inc
# SPDX-License-Identifier: Apache-2.0

sample:
  description: Operating Points sample
  name: Operating Points Sample
common:
  tags:
    - op_points
    - pm
  harness: console
  harness_config:
    type: multi_line
    regex:
      - "^Op-Points sample$"
      - "^Setting op-point: nominal$"
      - "^Setting op-point: performance$"
      - "^Clearing op-point$"

tests:
  sample.op_points.op_points:
    platform_allow:
      - frdm_mcxn236
    integration_platforms:
      - frdm_mcxn236
  sample.op_points.op_points_pm_device:
    platform_allow:
      - frdm_mcxn236
    integration_platforms:
      - frdm_mcxn236
    extra_configs:
      - CONFIG_PM_DEVICE=y
  sample.op_points.op_points_pm_device_runtime:
    platform_allow:
      - frdm_mcxn236
    integration_platforms:
      - frdm_mcxn236
    extra_configs:
      - CONFIG_PM_DEVICE=y
      - CONFIG_PM_DEVICE_RUNTIME=y
```

## prj.conf
```kconfig
# Copyright 2026 NXP
# SPDX-License-Identifier: Apache-2.0

CONFIG_LOG=n
CONFIG_PRINTK=y

CONFIG_CPU_FREQ=y
CONFIG_CPU_FREQ_POLICY_ON_DEMAND=y
CONFIG_OP_POINTS=y
```

## boards/frdm_mcxn236.overlay
```dts
/*
 * Copyright 2026 NXP
 *
 * SPDX-License-Identifier: Apache-2.0
 */

#include <zephyr/dt-bindings/adc/adc.h>
#include <zephyr/dt-bindings/adc/mcux-lpadc.h>

/ {
	op_points {
		compatible = "zephyr,op-points";

		perf: perf {
			p-states = <&pstate_1 &pstate_2>;
			devices = <&flexcomm2_lpuart2>;
		};

		nom: nom {
			p-states = <&pstate_1>;
		};
	};
};
```

## src/main.c
```c
/*
 * Copyright 2026 NXP
 *
 * SPDX-License-Identifier: Apache-2.0
 */

#include <stdbool.h>
#include <stdint.h>

#include <zephyr/device.h>
#include <zephyr/devicetree.h>
#include <zephyr/kernel.h>
#include <zephyr/sys/printk.h>
#include <zephyr/op_points/op_points.h>

const struct op_point *perf = OP_POINT_DT_GET(DT_NODELABEL(perf));

const struct op_point *nom = OP_POINT_DT_GET(DT_NODELABEL(nom));

int main(void)
{

	printk("Op-Points sample\n");

	while (1) {
		k_sleep(K_SECONDS(2));
		printk("Setting op-point: nominal\n");
		op_point_activate(nom);

		k_sleep(K_SECONDS(2));
		printk("Setting op-point: performance\n");
		op_point_activate(perf);

		k_sleep(K_SECONDS(2));
		printk("Clearing op-point\n");
		op_point_clear();
	}
}
```
